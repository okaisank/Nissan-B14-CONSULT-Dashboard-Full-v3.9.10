## B14_v310/components/esp_lcd/Kconfig
```kconfig
menu "ESP-Driver:LCD Controller Configurations (SPI-only Nissan B14 override)"
    config LCD_ENABLE_DEBUG_LOG
        bool "Enable debug log"
        default n
        help
            Enable debug logging for the ESP LCD SPI driver used by this project.
endmenu
```
